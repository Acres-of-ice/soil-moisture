## sdkconfig.defaults
```kconfig
# Logging Configuration
# Set default runtime log level to INFO
CONFIG_LOG_DEFAULT_LEVEL_INFO=y
CONFIG_LOG_DEFAULT_LEVEL=3

# Set maximum compile-time log level to DEBUG (allows all levels)
CONFIG_LOG_MAXIMUM_LEVEL_DEBUG=y
CONFIG_LOG_MAXIMUM_LEVEL=4

# Disable "maximum equals default" to allow runtime log level changes
CONFIG_LOG_MAXIMUM_EQUALS_DEFAULT=n

# Ensure other default levels are disabled
CONFIG_LOG_DEFAULT_LEVEL_NONE=n
CONFIG_LOG_DEFAULT_LEVEL_ERROR=n
CONFIG_LOG_DEFAULT_LEVEL_WARN=n
CONFIG_LOG_DEFAULT_LEVEL_DEBUG=n
CONFIG_LOG_DEFAULT_LEVEL_VERBOSE=n
#
# Ensure other maximum levels are disabled
CONFIG_LOG_MAXIMUM_LEVEL_NONE=n
CONFIG_LOG_MAXIMUM_LEVEL_ERROR=n
CONFIG_LOG_MAXIMUM_LEVEL_WARN=n
CONFIG_LOG_MAXIMUM_LEVEL_INFO=n
CONFIG_LOG_MAXIMUM_LEVEL_VERBOSE=n

# Bootloader logging
CONFIG_BOOTLOADER_LOG_LEVEL_INFO=y
CONFIG_BOOTLOADER_LOG_LEVEL=3
CONFIG_BOOTLOADER_LOG_LEVEL_NONE=n
CONFIG_BOOTLOADER_LOG_LEVEL_ERROR=n
CONFIG_BOOTLOADER_LOG_LEVEL_WARN=n
CONFIG_BOOTLOADER_LOG_LEVEL_DEBUG=n
CONFIG_BOOTLOADER_LOG_LEVEL_VERBOSE=n

# Force custom partition table
CONFIG_PARTITION_TABLE_SINGLE_APP=
CONFIG_PARTITION_TABLE_SINGLE_APP_LARGE=
CONFIG_PARTITION_TABLE_TWO_OTA=
CONFIG_PARTITION_TABLE_CUSTOM=y
CONFIG_PARTITION_TABLE_CUSTOM_FILENAME="partitions/master.csv"

# PPP Internet support
CONFIG_ESP_NETIF_TCPIP_LWIP=y
CONFIG_LWIP_PPP_SUPPORT=y
CONFIG_LWIP_PPP_PAP_SUPPORT=y
CONFIG_LWIP_PPP_CHAP_SUPPORT=y

# # Use system time for log timestamps instead of RTOS ticks
# CONFIG_LOG_COLORS=y
# CONFIG_LOG_TIMESTAMP_SOURCE_SYSTEM=y
# CONFIG_LOG_TIMESTAMP_SOURCE_RTOS=n
# CONFIG_LIBC_TIME_SYSCALL_RTC_SYSTIMER=y
#
## MQTT Configuration
CONFIG_MQTT_PROTOCOL_311=y
CONFIG_MQTT_TRANSPORT_SSL=n
CONFIG_MQTT_TRANSPORT_WEBSOCKET=n
CONFIG_MQTT_TRANSPORT_WEBSOCKET_SECURE=n

# TCP Configuration for cellular networks (correct symbols)
CONFIG_LWIP_TCP_KEEPALIVE=y
CONFIG_LWIP_TCP_KEEPIDLE=7200
CONFIG_LWIP_TCP_KEEPINTVL=75
CONFIG_LWIP_TCP_KEEPCNT=9

# TCP Buffer sizes
CONFIG_LWIP_TCP_SND_BUF_DEFAULT=8192
CONFIG_LWIP_TCP_WND_DEFAULT=8192

# Socket configuration
CONFIG_LWIP_MAX_SOCKETS=16
CONFIG_LWIP_SO_REUSE=y
CONFIG_LWIP_SO_RCVBUF=y

# MQTT specific TCP settings
CONFIG_LWIP_TCP_MSS=1460
CONFIG_LWIP_TCPIP_RECVMBOX_SIZE=32

# Memory management
CONFIG_LWIP_MEM_ALIGNMENT=4
CONFIG_LWIP_TCPIP_TASK_STACK_SIZE=4096

# Application Config
CONFIG_SITE_NAME='Test'
CONFIG_PCB='Master'

# Development and Debug Configuration
# Enable core dump to flash for debugging
CONFIG_ESP32_ENABLE_COREDUMP_TO_FLASH=y
CONFIG_ESP32_COREDUMP_DATA_FORMAT_ELF=y
CONFIG_ESP_COREDUMP_ENABLE_TO_FLASH=y

#
# Stack Overflow Protection
#
CONFIG_FREERTOS_CHECK_STACKOVERFLOW=y
CONFIG_FREERTOS_CHECK_STACKOVERFLOW_MODE=2
CONFIG_FREERTOS_WATCHPOINT_END_OF_STACK=y
CONFIG_FREERTOS_USE_TRACE_FACILITY=y
CONFIG_FREERTOS_GENERATE_RUN_TIME_STATS=y

# Ota download
CONFIG_ESP_CONSOLE_UART_TX_BUFFER_SIZE=2048
CONFIG_ESP_CONSOLE_UART_RX_BUFFER_SIZE=2048

#
# Heap Protection  
#
CONFIG_HEAP_POISONING_COMPREHENSIVE=y
CONFIG_HEAP_TRACING=y
CONFIG_ESP_SYSTEM_CHECK_STACK_OVERFLOW=y
```

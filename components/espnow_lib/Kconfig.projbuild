## components/espnow_lib/Kconfig.projbuild
```kconfig
menu "ESP-NOW Library Configuration"

    # config ESPNOW_PCB_NAME
    #     string "Device Identifier Name"
    #     default "ESP32-Device"
    #     help
    #         Set a custom name to identify this device during ESP-NOW discovery.
    #         This name will be used instead of MAC address for easier identification.

    config ESPNOW_CHANNEL
        int "WiFi Channel"
        default 6
        range 1 14
        help
            The WiFi channel on which ESP-NOW will operate. All devices must use the same channel.

    config ESPNOW_SEND_DELAY
        int "Send Delay (ms)"
        default 2000
        range 0 10000
        help
            Delay between sending two ESPNOW data packets, unit: ms.
    #
    # config ESPNOW_ENABLE_LONG_RANGE
    #     bool "Enable Long Range Mode"
    #     default "y"
    #     help
    #         When enabled, the PHY rate will be reduced to increase range at the expense of bandwidth.

    # config ESPNOW_ENABLE_ENCRYPTION
    #     bool "Enable Encryption"
    #     default "n"
    #     help
    #         Enable or disable encryption for ESP-NOW communication. When disabled, 
    #         communication will be unencrypted for better performance and lower power 
    #         consumption, but less secure.
    #
    # if ESPNOW_ENABLE_ENCRYPTION
    #     config ESPNOW_PMK
    #         string "ESPNOW primary master key"
    #         default "pmk1234567890123"
    #         help
    #             ESPNOW primary master key. The length should be 16 bytes.
    #             Only used when encryption is enabled.
    #
    #     config ESPNOW_LMK
    #         string "ESPNOW local master key"
    #         default "lmk1234567890123"
    #         help
    #             ESPNOW local master key. The length should be 16 bytes.
    #             Only used when encryption is enabled.
    # endif

    config ESPNOW_MAX_PEERS
        int "Maximum number of peers"
        default 10
        range 1 10
        help
            Maximum number of ESP-NOW peers that can be stored and managed.
    #
    # config ESPNOW_DISCOVERY_TIMEOUT
    #     int "Peer Discovery Timeout (ms)"
    #     default 30000
    #     range 1000 300000
    #     help
    #         Timeout for peer discovery phase in milliseconds.

    config ESPNOW_USE_STORED_MAPPINGS
        bool "Use stored device mappings"
        default "y"
        help
            When enabled, ESP-NOW will try to load device-to-MAC address mappings from NVS
            instead of running a full discovery process. Discovery will only run if no valid
            mappings are found or if manually triggered.

    config ESPNOW_FORCE_DISCOVERY
        bool "Force device discovery"
        default "n"
        depends on ESPNOW_USE_STORED_MAPPINGS
        help
            When enabled along with USE_STORED_MAPPINGS, a discovery will always be performed
            on boot, but the results will be saved to NVS for future use.

endmenu
```

## main/Kconfig.projbuild
```kconfig
menu "App Configuration"
    choice SITE_SELECT
        prompt "Select Site"
        default SITE_TEST
        
        config SITE_SKUAST
            bool "Skuast"

        config SITE_TEST
            bool "Test"
    endchoice

    config SITE_NAME
        string
        default "Test" if SITE_TEST
        default "Skuast" if SITE_SKUAST

    config NUM_PLOTS
        int "Number of irrigation plots"
        range 1 8
        default 2
        help
            Set the number of irrigation plots (soil sensors + valves).
            Each plot has one soil sensor and one valve.
            Default is 2 for backward compatibility.

    choice PCB
        prompt "Select PCB Configuration"
        help
            Choose the pcb type.
        config MASTER
            bool "MASTER as sensor master"
            help
                Configure MASTER
        config SOIL
            bool "Soil Sensor"
            help
                Configure as soil sensor. The plot number will be set separately.
        config VALVE
            bool "Valve Controller"
            help
                Configure as valve controller. The plot number will be set separately.
        config SOLENOID
            bool "Solenoid Controller"
            help
                Configure as solenoid controller. The plot number will be set separately.
        config PUMP
            bool "PUMP"
            help
                Configure Pump.
    endchoice

    config SOIL_SENSOR_DEEP_SLEEP_ON_LOW_BATT
    bool "Enable deep sleep on low battery"
    default y if SOIL
    depends on SOIL
    help
        If enabled, the ESP will enter deep sleep for 1 hour when battery voltage falls below SOIL_BATT_MIN_VOLTAGE.

    config PLOT_NUMBER
        int "Plot Number (1-8)"
        range 1 8
        default 1
        depends on SOIL || VALVE || SOLENOID
        help
            Set the plot number for this soil sensor or valve.
            This will determine the device address and PCB name.
            Plot 1 = Soil 1/Valve 1, Plot 2 = Soil 2/Valve 2, etc.

    config ESPTOOLPY_FLASHSIZE
        string
        default "8MB" if MASTER
        default "4MB" if VALVE || SOIL || PUMP || SOLENOID

    config ESPTOOLPY_FLASHSIZE_8MB
        string
        default "y" if MASTER
        default "n" if VALVE || SOIL || PUMP || SOLENOID

    config ESPTOOLPY_FLASHSIZE_4MB
        string
        default n if MASTER
        default y if VALVE || SOIL || PUMP || SOLENOID

    config ESPTOOLPY_FLASHSIZE_2MB
        string
        default "n" if MASTER
        default "n" if VALVE || SOIL || PUMP || SOLENOID

    config PARTITION_TABLE_SINGLE_APP
        bool
        default n
        help
            Use custom partition table based on PCB type

    config PARTITION_TABLE_CUSTOM
        bool
        default y
        help
            Use custom partition table based on PCB type

    config PARTITION_TABLE_CUSTOM_FILENAME
        string
        default "partitions/master.csv" if MASTER
        default "partitions/valves.csv" if VALVE || SOIL || PUMP || SOLENOID

    # CPU Frequency Configuration
    config ESP_DEFAULT_CPU_FREQ_MHZ_80
        bool
        default y if (VALVE || SOIL || PUMP || SOLENOID)
        default n if MASTER

    config ESP_DEFAULT_CPU_FREQ_MHZ_160  
        bool
        default n
        
    config ESP_DEFAULT_CPU_FREQ_MHZ_240
        bool  
        default y if MASTER
        default n if (VALVE || SOIL || PUMP || SOLENOID)

    # Also set the main frequency value to match
    config ESP_DEFAULT_CPU_FREQ_MHZ
        int
        default 240 if MASTER
        default 80 if (VALVE || SOIL || PUMP || SOLENOID)

    # Debugging
    config CONFIG_ESP32_ENABLE_COREDUMP_TO_UART
        bool
        default n if MASTER
        default y if VALVE || SOIL || PUMP || SOLENOID

    config CONFIG_ESP32_ENABLE_COREDUMP_TO_FLASH
        bool
        default y if MASTER
        default n if VALVE || SOIL || PUMP || SOLENOID

config ENABLE_HW
    bool "Enable Hardware Configuration"
    default false
    help
        Enable to customize hardware settings. If disabled, site defaults will be used.

menu "Hardware Configuration"
	visible if ENABLE_HW

	config LCD_ADDR_3F
		bool "Use LCD I2C address 0x3F"
		default y
		help
			Enable this for sites using LCD with I2C address 0x3F.

        config HAS_VALVE
            bool "Use Valves"
            default y
            help
                Enable valve for sites
        config ENABLE_VALVE
            int
            default 1 if HAS_VALVE
            default 0

        config HAS_GSM
            bool "Use GSM"
            default y
            help
                Enable GSM for sites
        config ENABLE_GSM
            int
            default 1 if HAS_GSM
            default 0

        config HAS_TEMP_HUMIDITY
            bool "Enable Temperature Sensor"
            default y
            help
                Enable if site has a temp sensor.
        config ENABLE_TEMP_HUMIDITY
            int
            default 1 if HAS_TEMP_HUMIDITY
            default 0

        config HAS_FLOWMETER
            bool "Enable Flowmeter"
            default y
            help
                Enable if site has a flowmeter.
        config ENABLE_FLOWMETER
            int
            default 1 if HAS_FLOWMETER
            default 0

        config HAS_PRESSURE
            bool "Enable pressure sensor"
            default y
            help
                Enable if site has a pressure sensor.
        config ENABLE_PRESSURE
            int
            default 1 if HAS_PRESSURE
            default 0

        config HAS_VOLTAGE_CUTOFF
            bool "Enable Low Voltage Auto Cutoff"
            default y
            help
                Enable low voltage auto cutoff for sites
        config ENABLE_VOLTAGE_CUTOFF
            int
            default 1 if HAS_VOLTAGE_CUTOFF
            default 0
        config HAS_CALIBRATION
            bool "Does the calibration for soil moisture sensor"
            default n
            help
                Enable calibration for soil moisture sensor
        config ENABLE_CALIBRATION
            int
            default 1 if HAS_CALIBRATION
            default 0

endmenu

config ENABLE_DRIP_TIMER
	bool "Enable Drip Timer"
	default false
	help
		Enable this option to set a custom drain time range. If disabled, draining will occur based on other conditions only.

menu "Drip Timer Configuration"
	visible if ENABLE_DRIP_TIMER

	config DRIP_START_HOUR
		int "Drip start hour (0-23)"
		default 0
		range 0 23
		help
			Set the hour when the forced drain time starts (24-hour format).

	config DRIP_START_MINUTE
		int "Drip start minute (0-59)"
		default 0
		range 0 59
		help
			Set the minute when the forced drain time starts.

	config DRIP_END_HOUR
		int "Drip end hour (0-23)"
		default 23
		range 0 23
		help
			Set the hour when the forced drain time ends (24-hour format).

	config DRIP_END_MINUTE
		int "Drip end minute (0-59)"
		default 59
		range 0 59
		help
			Set the minute when the forced drain time ends.
endmenu

config ENABLE_TIME_CONFIG
    bool "Enable Timeout Configuration"
    default false
    help
        Enable this option to customize timeout settings. If disabled, default values will be used.

menu "Time Configuration"
    visible if ENABLE_TIME_CONFIG

    config STATE_TIMEOUT_M
        int "State machine timeout (minutes)"
        default 1 if SITE_TEST
        default 60
        range 1 180
        help
            Timeout for state machine in minutes.

    config VALVE_TIMEOUT_S
        int "Valve operation timeout (seconds)"
        default 1 if SITE_TEST
        default 90
        range 1 3600
        help
            Timeout for valve operations in seconds.

    config SERVER_TIMEOUT_M
        int "Server timeout (minutes)"
        default 2 if SITE_TEST
        default 5
        range 1 60
        help
            Interval for keeping server on

    config DATA_INTERVAL_M
        int "Data logging interval (minutes)"
        default 1 if SITE_TEST
        default 5
        range 1 60
        help
            Interval for data logging in seconds (default: 5 minutes).

    config ERROR_DURATION_M
        int "Error duration (minutes)"
        default 1 if SITE_TEST
        default 120
        range 1 600
        help
            Set the interval in minutes for calibration task.

    config ERROR_CHECK_DELAY_S
        int "Error check delay after pump start (seconds)"
        default 3 if SITE_TEST
        default 60
        range 1 300
        help
            Time to wait after pump starts before beginning error detection.
            This prevents false positives during pump startup transients.

    config POLL_INTERVAL_S
        int "Poll interval (seconds)"
        default 1 if SITE_TEST
        default 5
        range 1 600
        help
            Set the interval in seconds between sensor readings.

    config LOW_VOLTAGE_SLEEP_M
        int "Low Voltage sleep"
        default 5 if SITE_TEST
        default 60
        range 1 600
        help
            Set the interval in minutes to check for new data to send via SMS.

    config SMS_INTERVAL_M
        int "Hex data and sms send interval (minutes)"
        default 10 if SITE_TEST
        default 20
        range 1 60
        help
            Timeout for SMS and HEX  in minutes.


endmenu

config ENABLE_ERROR_CONFIG
    bool "Enable Error Configuration"
    default y
    help
        Enable this option to customize error settings. If disabled, default values will be used.

menu "Error Detection Thresholds"
    visible if ENABLE_ERROR_CONFIG

    config WATER_TEMP_ERROR_THRESHOLD
        int "Water temperature error threshold (°C)"
        default 3
        range -10 15
        help
            Water temperature below this value triggers error state.
            Low water temperature may indicate frozen pipes or sensor malfunction.

    config ERROR_VALIDATION_READINGS
        int "Number of consecutive readings to validate error"
        default 1 if SITE_TEST
        default 5
        range 1 10
        help
            Number of consecutive sensor readings that must meet error conditions
            before triggering error state. This prevents false positives from
            temporary sensor fluctuations.

    config MAX_CONSECUTIVE_ERRORS
        int "Maximum consecutive errors per plot"
        default 1 if SITE_TEST
        default 3
        range 1 10
        help
            Number of consecutive errors from the same plot before that specific plot
            is disabled and requires manual intervention. This prevents a single
            faulty plot from repeatedly failing and wasting water/energy.
            
            Example: If set to 3, after 3 consecutive irrigation failures on Plot 1,
            that plot will be skipped in future irrigation cycles until manually reset.
            Other plots will continue to operate normally.

endmenu

config ENABLE_SIMULATION_MODE
    int
    default 1 if SITE_TEST
    default 0
    help
        Enable simulation mode which uses fixed simulated sensor readings instead of real sensor data.

menu "Plot Moisture Thresholds"
    config PLOT_DRY
        int "Plot Dry Threshold (%)"
        range 0 100
        default 40
        help
            Set the soil moisture threshold below which irrigation will start.
            Value is a percentage (0-100). Lower values mean drier soil.
            Example: 40 means irrigation starts when moisture falls below 40%.
            
    config PLOT_WET
        int "Plot Wet Threshold (%)"
        range 0 100
        default 70
        help
            Set the soil moisture threshold at which irrigation will stop.
            Value is a percentage (0-100). Higher values mean wetter soil.
            Example: 70 means irrigation stops when moisture reaches 70%.
endmenu

config ENABLE_SET_TIME
    bool "Enable SNTP Time Synchronization"
    default false
    help
        Enable SNTP time synchronization during initialization. 
        If disabled, weekly updates will still be enabled for time drift correction.

config SET_TIME
    int
    default 1 if ENABLE_SET_TIME
    default 0

endmenu
```
